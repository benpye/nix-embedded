## images/ebaz4205/uboot-fit/ebaz4205.its
```
/dts-v1/;

/ {
	description = "U-Boot";
	#address-cells = <1>;

	images {
		uboot {
			description = "U-Boot (32-bit)";
			data = /incbin/("u-boot-nodtb.bin");
			type = "standalone";
			os = "U-Boot";
			arch = "arm";
			compression = "none";
			load = <0x4000000>;
			entry = <0x4000000>;
		};

		fdt {
			description = ".dtb";
			data = /incbin/("u-boot.dtb");
			type = "flat_dt";
			arch = "arm";
			compression = "none";
		};

		fpga {
			description = "FPGA";
			data = /incbin/("pl.bin");
			type = "fpga";
			compression = "none";
			compatible = "u-boot,fpga-legacy";
			load = <0x6000000>;
		};
	};

	configurations {
		default = "config";
		config {
			description = "U-Boot with fpga";
			firmware = "uboot";
			fdt = "fdt";
			fpga = "fpga";
		};
	};
};
```
